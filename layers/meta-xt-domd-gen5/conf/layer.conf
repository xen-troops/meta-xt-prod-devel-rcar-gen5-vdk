## layers/meta-xt-domd-gen5/conf/layer.conf
```bitbake
# We have a conf and classes directory, add to BBPATH
BBPATH .= ":${LAYERDIR}"

# We have a packages directory, add to BBFILES
BBFILES += "${LAYERDIR}/recipes-*/*/*.bb \
            ${LAYERDIR}/recipes-*/*/*.bbappend"

BBFILE_COLLECTIONS += "meta-xt-domd-gen5"
BBFILE_PATTERN_meta-xt-domd-gen5 := "^${LAYERDIR}/"
BBFILE_PRIORITY_meta-xt-domd-gen5 = "12"

LAYERSERIES_COMPAT_meta-xt-domd-gen5 = "kirkstone"
```

## layers/meta-xt-domx-gen5/conf/layer.conf
```bitbake
# We have a conf and classes directory, add to BBPATH
BBPATH .= ":${LAYERDIR}"

# We have a packages directory, add to BBFILES
BBFILES += "${LAYERDIR}/recipes-*/*/*.bb \
            "

BBFILES_DYNAMIC += " \
virtualization-layer:${LAYERDIR}/recipes-extended/xen/*.bbappend \
rcar-gateway:${LAYERDIR}/recipes-bsp/optee*/*.bbappend \
"


BBFILE_COLLECTIONS += "xt-domx-gen5"
BBFILE_PATTERN_xt-domx-gen5 := "^${LAYERDIR}/"
BBFILE_PRIORITY_xt-domx-gen5 = "12"

LAYERSERIES_COMPAT_xt-domx-gen5 = "kirkstone"
```
